## firmware/esp32/boards/esp32-s3-box-3/sdkconfig.defaults
```kconfig
# ESP32-S3-BOX-3: 16 MB flash and octal PSRAM.
CONFIG_IDF_TARGET="esp32s3"
# CONFIG_ESPTOOLPY_FLASHSIZE_4MB is not set
CONFIG_ESPTOOLPY_FLASHSIZE_16MB=y
CONFIG_SPIRAM=y
CONFIG_SPIRAM_MODE_OCT=y
CONFIG_SPIRAM_SPEED_80M=y
CONFIG_SPIRAM_USE_MALLOC=y
CONFIG_SPIRAM_IGNORE_NOTFOUND=y
CONFIG_ESP_DEFAULT_CPU_FREQ_MHZ_240=y
# CONFIG_ESP_CONSOLE_UART_DEFAULT is not set
CONFIG_ESP_CONSOLE_USB_SERIAL_JTAG=y
CONFIG_ESP_LCD_TOUCH_MAX_BUTTONS=1
CONFIG_HG_BOARD_BOX3=y
```

## firmware/esp32/main/Kconfig.projbuild
```kconfig
menu "Hermes Gadget"

    menu "Defaults (overridable from the serial console)"
        config HG_DEFAULT_NAME
            string "Device name"
            default "Hermes Gadget"
        config HG_DEFAULT_SERVER_URL
            string "Hermes gadget endpoint"
            default ""
            help
                ws://<hermes-host>:8765/gadget  (run 'hermes gadget info' on the host).
                Leave empty to configure it over serial: set server <url>
        config HG_DEFAULT_ACCESS_TOKEN
            string "Access token (only if GADGET_ACCESS_TOKEN is set on the host)"
            default ""
        config HG_DEFAULT_WIFI_SSID
            string "Wi-Fi SSID"
            default ""
        config HG_DEFAULT_WIFI_PASSWORD
            string "Wi-Fi password"
            default ""
    endmenu

    config HG_WIFI_REUSE_IP
        bool "Reuse the last DHCP address on a fast Wi-Fi rejoin"
        default n
        help
            When the device rejoins the access point that last worked, take the
            address, gateway and DNS server it last got from DHCP as a static
            address instead of asking DHCP again. Only for a router that reserves
            that address for the device: nothing renews the lease, and an address
            given to someone else in the meantime conflicts. Every other join uses
            DHCP. Without this option the device still asks DHCP for its last
            address first (CONFIG_LWIP_DHCP_RESTORE_LAST_IP), which skips the
            discovery round. docs/hardware.md#wi-fi-reconnect

    config HG_TAILNET
        bool "Join a Tailscale tailnet (experimental)"
        default n
        depends on SPIRAM
        help
            Builds in TailTiny, a third-party Tailscale client
            (components/TAILTINY.md), so the device can reach a Hermes
            gateway that only listens on its tailnet address, from any
            network. The board also needs BoardConfig::tailnet, and the user
            turns it on with `set tailnet on` and an auth key (`set ts_key`).
            Adds about 108 KB of flash on the AMOLED-1.75C. Off on every
            board and in release images. docs/tailnet.md

    config HG_FRAME_STATS
        bool "Time every frame from boot"
        default n
        help
            Measure how long each screen update takes to draw and to send to
            the panel, and how long a button or touch waits for it, from boot.
            Without this option the timing stays off until the console's
            `perf on`, and costs one check per screen update.
            docs/development.md#measure-frame-timing

    config HG_FRAME_BUDGET_US
        int "Frame budget (microseconds)"
        default 16667
        range 1 10000000
        help
            Frames that take longer count as missed. 16667 is one 60 Hz refresh.
            The console's `perf budget` changes it until the next restart.

    config HG_FRAME_LOG_S
        int "Seconds between frame timing summaries in the log (0: none)"
        default 10
        range 0 3600

    choice HG_BOARD
        prompt "Board"
        default HG_BOARD_ESP32S3_BREADBOARD
        help
            Pin maps and peripherals. Add a board: docs/porting.md

        config HG_BOARD_ESP32S3_BREADBOARD
            bool "ESP32-S3 breadboard (ST7789 + INMP441 + MAX98357A)"
        config HG_BOARD_AMOLED_175
            bool "Waveshare ESP32-S3-Touch-AMOLED-1.75 (round AMOLED, touch, codecs)"
        config HG_BOARD_AMOLED_175C
            bool "Waveshare ESP32-S3-Touch-AMOLED-1.75C (32 MB flash, enclosed AMOLED)"
        config HG_BOARD_WS_ESP32S3_TOUCH_AMOLED_132
            bool "Waveshare ESP32-S3-Touch-AMOLED-1.32 (experimental, round CO5300 466x466, CST820, ES8311)"
        config HG_BOARD_AMOLED_18
            bool "Waveshare ESP32-S3-Touch-AMOLED-1.8 (rectangular AMOLED, CST820 touch, ES8311)"
        config HG_BOARD_AMOLED_206
            bool "Waveshare ESP32-S3-Touch-AMOLED-2.06 (watch, 410x502 AMOLED, FT3168 touch)"
        config HG_BOARD_AMOLED_216
            bool "Waveshare ESP32-S3-Touch-AMOLED-2.16 (480x480 AMOLED, CST9220 touch, ES8311 + ES7210)"
        config HG_BOARD_BOX3
            bool "Espressif ESP32-S3-BOX-3 (LCD, touch, ES8311 + ES7210)"
        config HG_BOARD_CORES3
            bool "M5Stack CoreS3 (LCD, touch, AW88298 + ES7210)"
        config HG_BOARD_STICKS3
            bool "M5Stack StickS3 (experimental, ST7789 240x135, ES8311, M5PM1)"
        config HG_BOARD_WS_ESP32S3_LCD_154
            bool "Waveshare ESP32-S3-LCD-1.54 (ST7789 240x240, ES8311 + ES7210 codecs)"
        config HG_BOARD_WS_ESP32S3_TOUCH_LCD_183
            bool "Waveshare ESP32-S3-Touch-LCD-1.83 (experimental, ST7789 240x284, CST816D, ES8311 + ES7210)"
        config HG_BOARD_WS_ESP32S3_TOUCH_LCD_185C_V2
            bool "Waveshare ESP32-S3-Touch-LCD-1.85C V2 (experimental, ST77916, CST816, codecs)"
        config HG_BOARD_WS_KNOB_LCD_18
            bool "Waveshare ESP32-S3-Knob-Touch-LCD-1.8 (SH8601 360x360 round, encoder, text-only audio)"
        config HG_BOARD_ESP_VOCAT
            bool "Espressif ESP-VoCat v1.2 (experimental, ST77916 360x360, CST816S, ES8311 + ES7210)"
        config HG_BOARD_T_DISPLAY_S3
            bool "LilyGO T-Display-S3 (ST7789 320x170 on an i80 parallel bus, no audio)"
        config HG_BOARD_AIPI_LITE
            bool "AIPI Lite (128x128 ST7789, ES8311 codec, battery)"
        config HG_BOARD_SPOTPEAR_MUMA
            bool "Spotpear ESP32-S3-1.54 muma (experimental, ST7789 240x240, CST816D, ES8311)"
        config HG_BOARD_SPOTPEAR_BOX128
            bool "Spotpear ESP32-S3-1.28-BOX (experimental, round GC9A01 240x240, CST816D, ES8311)"
        config HG_BOARD_CROWPANEL_21
            bool "Elecrow CrowPanel 2.1-inch HMI (480x480 RGB, rotary, touch)"
        config HG_BOARD_CROWPANEL_50
            bool "Elecrow CrowPanel 5.0-inch HMI (800x480 RGB ILI6122, GT911 touch)"
        config HG_BOARD_CROWPANEL_P4_101
            bool "Elecrow CrowPanel Advanced 10.1-inch ESP32-P4 (1024x600 DSI, GT911)"
            depends on IDF_TARGET_ESP32P4
        config HG_BOARD_ESP32_CYD
            bool "ESP32-2432S028 CYD (ST7789 320x240, no PSRAM, experimental)"
            depends on IDF_TARGET_ESP32
        config HG_BOARD_WS_P4_TOUCH_LCD_3_4C
            bool "Waveshare ESP32-P4-WIFI6-Touch-LCD-3.4C (800x800 round DSI, ES8311+ES7210 audio, C6 Wi-Fi)"
            depends on IDF_TARGET_ESP32P4
        config HG_BOARD_WS_P4_TOUCH_LCD_7B
            bool "Waveshare ESP32-P4-WIFI6-Touch-LCD-7B (1024x600 DSI, GT911 touch, ES8311+ES7210 audio, C6 Wi-Fi)"
            depends on IDF_TARGET_ESP32P4
        config HG_BOARD_CUSTOM
            bool "Custom pins (configure below)"
    endchoice

    menu "Custom board pins"
        depends on HG_BOARD_CUSTOM

        config HG_LCD_ENABLED
            bool "SPI LCD (ST7789)"
            default y
        config HG_LCD_WIDTH
            int "LCD width (after rotation)"
            default 320
            depends on HG_LCD_ENABLED
        config HG_LCD_HEIGHT
            int "LCD height (after rotation)"
            default 240
            depends on HG_LCD_ENABLED
        config HG_LCD_SWAP_XY
            bool "Landscape (swap X/Y)"
            default y
            depends on HG_LCD_ENABLED
        config HG_LCD_MIRROR_X
            bool "Mirror X"
            default y
            depends on HG_LCD_ENABLED
        config HG_LCD_MIRROR_Y
            bool "Mirror Y"
            default n
            depends on HG_LCD_ENABLED
        config HG_LCD_INVERT
            bool "Invert colours (most IPS ST7789 panels)"
            default y
            depends on HG_LCD_ENABLED
        config HG_LCD_GAP_X
            int "Column offset"
            default 0
            depends on HG_LCD_ENABLED
        config HG_LCD_GAP_Y
            int "Row offset"
            default 0
            depends on HG_LCD_ENABLED
        config HG_LCD_PIN_MOSI
            int "LCD MOSI"
            default 11
        config HG_LCD_PIN_SCLK
            int "LCD SCLK"
            default 12
        config HG_LCD_PIN_CS
            int "LCD CS"
            default 10
        config HG_LCD_PIN_DC
            int "LCD DC"
            default 9
        config HG_LCD_PIN_RST
            int "LCD RST (-1 if tied)"
            default 8
        config HG_LCD_PIN_BL
            int "LCD backlight (-1 if always on)"
            default 7
        config HG_LCD_SPI_MHZ
            int "LCD SPI clock (MHz)"
            default 40

        config HG_MIC_ENABLED
            bool "I2S microphone (INMP441-style, 24-bit left slot)"
            default y
        config HG_MIC_PIN_SCK
            int "Mic SCK/BCLK"
            default 4
        config HG_MIC_PIN_WS
            int "Mic WS/LRCLK"
            default 5
        config HG_MIC_PIN_SD
            int "Mic SD/DOUT"
            default 6

        config HG_SPK_ENABLED
            bool "I2S amplifier (MAX98357A-style)"
            default y
        config HG_SPK_PIN_BCLK
            int "Speaker BCLK"
            default 15
        config HG_SPK_PIN_WS
            int "Speaker LRC/WS"
            default 16
        config HG_SPK_PIN_DOUT
            int "Speaker DIN"
            default 17

        config HG_BTN_TALK
            int "Talk button GPIO (active low)"
            default 0
        config HG_BTN_CANCEL
            int "Cancel button GPIO (-1 = none)"
            default 14
        config HG_BTN_UP
            int "Scroll-up button GPIO (-1 = none)"
            default -1
        config HG_BTN_DOWN
            int "Scroll-down button GPIO (-1 = none)"
            default -1
        config HG_STATUS_LED
            int "Status LED GPIO, exposed to the agent as led.set (-1 = none)"
            default -1
    endmenu

endmenu
```
